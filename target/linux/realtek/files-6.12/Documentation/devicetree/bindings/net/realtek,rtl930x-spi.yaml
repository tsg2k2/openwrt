## target/linux/realtek/files-6.12/Documentation/devicetree/bindings/net/realtek,rtl930x-spi.yaml
```yaml
# SPDX-License-Identifier: (GPL-2.0-only OR BSD-2-Clause)
%YAML 1.2
---
$id: http://devicetree.org/schemas/net/realtek,rtl930x-spi.yaml#
$schema: http://devicetree.org/meta-schemas/core.yaml#

title: Realtek RTL930x Ethernet Switch SPI Interface

maintainers:
  - OpenWrt RTL930x Team <openwrt-devel@lists.openwrt.org>

description: |
  The Realtek RTL930x series Ethernet switches can be controlled via SPI
  interface for register access. This binding describes the SPI slave
  interface configuration.

allOf:
  - $ref: /schemas/spi/spi-peripheral-props.yaml#

properties:
  compatible:
    enum:
      - realtek,rtl9300-spi
      - realtek,rtl9302-spi  
      - realtek,rtl9303-spi

  reg:
    maxItems: 1

  spi-max-frequency:
    description: Maximum SPI clock frequency
    minimum: 1000000
    maximum: 10000000
    default: 10000000

  reset-gpios:
    description: GPIO for hardware reset of the switch chip
    maxItems: 1

  cs-gpios:
    description: GPIO for manual chip select control (optional)
    maxItems: 1

  interrupts:
    description: Interrupt line from switch to host processor
    maxItems: 1

  interrupt-parent:
    description: Interrupt controller for switch interrupts

required:
  - compatible
  - reg
  - spi-max-frequency

additionalProperties: false

examples:
  - |
    #include <dt-bindings/gpio/gpio.h>
    #include <dt-bindings/interrupt-controller/irq.h>
    
    spi {
        #address-cells = <1>;
        #size-cells = <0>;
        
        ethernet-switch@0 {
            compatible = "realtek,rtl9300-spi";
            reg = <0>;
            spi-max-frequency = <10000000>;
            
            reset-gpios = <&gpio 12 GPIO_ACTIVE_LOW>;
            cs-gpios = <&gpio 8 GPIO_ACTIVE_LOW>;
            
            interrupt-parent = <&gpio>;
            interrupts = <15 IRQ_TYPE_LEVEL_LOW>;
            
            ports {
                #address-cells = <1>;
                #size-cells = <0>;
                
                port@0 {
                    reg = <0>;
                    label = "lan1";
                    phy-handle = <&phy0>;
                };
                
                port@1 {
                    reg = <1>;
                    label = "lan2";
                    phy-handle = <&phy1>;
                };
                
                port@28 {
                    reg = <28>;
                    label = "cpu";
                    ethernet = <&ethernet>;
                    phy-mode = "internal";
                    
                    fixed-link {
                        speed = <1000>;
                        full-duplex;
                    };
                };
            };
            
            mdio {
                compatible = "realtek,rtl930x-mdio";
                #address-cells = <1>;
                #size-cells = <0>;
                
                phy0: ethernet-phy@0 {
                    reg = <0>;
                };
                
                phy1: ethernet-phy@1 {
                    reg = <1>;
                };
            };
        };
    };
```
